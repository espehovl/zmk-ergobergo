## app/boards/seeed/xiao_mg24/Kconfig.xiao_mg24
```kconfig
# Copyright (c) 2026 The ZMK Contributors
# SPDX-License-Identifier: MIT

config BOARD_XIAO_MG24
    select ZMK_BOARD_COMPAT if BOARD_XIAO_MG24_EFR32MG24B220F1536IM48_ZMK
```

## app/boards/seeed/xiao_mg24/board.yml
```yaml
# Copyright (c) 2026 The ZMK Contributors
# SPDX-License-Identifier: MIT

board:
  extend: xiao_mg24
  variants:
    - name: zmk
      qualifier: efr32mg24b220f1536im48
```

## app/boards/shields/ergo_pack_v1/Kconfig.defconfig
```kconfig
# Copyright (c) 2026 The ZMK Contributors
# SPDX-License-Identifier: MIT

if SHIELD_ERGO_PACK_V1_LEFT

config ZMK_KEYBOARD_NAME
    default "Ergo Pack v1"

config ZMK_SPLIT_ROLE_CENTRAL
    default y

endif

if SHIELD_ERGO_PACK_V1_LEFT || SHIELD_ERGO_PACK_V1_RIGHT

config ZMK_SPLIT
    default y

endif
```

## app/boards/shields/ergo_pack_v1/Kconfig.shield
```kconfig
# Copyright (c) 2026 The ZMK Contributors
# SPDX-License-Identifier: MIT

config SHIELD_ERGO_PACK_V1_LEFT
    def_bool $(shields_list_contains,ergo_pack_v1_left)

config SHIELD_ERGO_PACK_V1_RIGHT
    def_bool $(shields_list_contains,ergo_pack_v1_right)
```
